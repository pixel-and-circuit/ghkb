#include "ghkb.dtsi"

&default_transform {
    col-offset = <6>;
};

&kscan0 {
    col-gpios
        = <&pro_micro 14 GPIO_ACTIVE_HIGH>  // inner / thumb-far
        , <&pro_micro 15 GPIO_ACTIVE_HIGH>  // index / thumb-home
        , <&pro_micro 18 GPIO_ACTIVE_HIGH>  // middle / thumb-near
        , <&pro_micro 19 GPIO_ACTIVE_HIGH>  // ring
        , <&pro_micro 20 GPIO_ACTIVE_HIGH>  // pinky
        , <&pro_micro 21 GPIO_ACTIVE_HIGH>  // outer
        ;
};
