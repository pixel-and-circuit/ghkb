## config/boards/shields/ghkb/Kconfig.defconfig
```kconfig
if SHIELD_GHKB_LEFT

config ZMK_KEYBOARD_NAME
	default "ghkb"

config ZMK_SPLIT_ROLE_CENTRAL
	default y

endif # SHIELD_GHKB_LEFT

if SHIELD_GHKB_LEFT || SHIELD_GHKB_RIGHT

config ZMK_SPLIT
	default y

endif # SHIELD_GHKB_LEFT || SHIELD_GHKB_RIGHT
```

## config/boards/shields/ghkb/Kconfig.shield
```kconfig
config SHIELD_GHKB_LEFT
	def_bool $(shields_list_contains,ghkb_left)

config SHIELD_GHKB_RIGHT
	def_bool $(shields_list_contains,ghkb_right)
```
